## drivers/gpu/drm/sunxi/Kconfig
```kconfig
#
# Allwinner Video configuration
#

config DRM_SUNXI
	tristate "DRM Support for Allwinner Video"
	depends on DRM && ARCH_SUNXI
	depends on OF
	select DRM_KMS_HELPER
	select DRM_KMS_CMA_HELPER
	select DRM_GEM_CMA_HELPER
	help
	  Choose this option if you have a Allwinner chipset.

config DRM_SUNXI_DE2
	tristate "Support for Allwinner Video with DE2 interface"
	depends on DRM_SUNXI
	select SND_PCM_ELD
	select SND
	select SOUND
	select SND_SOC
	select SND_SOC_GENERIC_DMAENGINE_PCM
	help
	  Choose this option if your Allwinner chipset has the DE2 interface
	  as the H3. The option enables HDMI support (both audio and video).
```
